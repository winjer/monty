## crates/monty-esp32/sdkconfig.defaults
```kconfig
# Common settings for all ESP32 targets

# Stack size for main task — Monty VM needs room for Python recursion
CONFIG_ESP_MAIN_TASK_STACK_SIZE=32768
```

## crates/monty-esp32/sdkconfig.defaults.esp32
```kconfig
# Huzzah32 Feather: ESP32-WROOM-32, 4MB flash, no PSRAM

# Flash size
CONFIG_ESPTOOLPY_FLASHSIZE_4MB=y

# Stack size for main task
CONFIG_ESP_MAIN_TASK_STACK_SIZE=32768
```

## crates/monty-esp32/sdkconfig.defaults.esp32s3
```kconfig
# M5Stack Cardputer: ESP32-S3FN8, 8MB flash, no PSRAM

# Flash size
CONFIG_ESPTOOLPY_FLASHSIZE_8MB=y
```
